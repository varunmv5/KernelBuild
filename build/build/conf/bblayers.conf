## build/build/conf/bblayers.conf
```bitbake
# POKY_BBLAYERS_CONF_VERSION is increased each time build/conf/bblayers.conf
# changes incompatibly
POKY_BBLAYERS_CONF_VERSION = "2"

BBPATH = "${TOPDIR}"
BBFILES ?= ""

BBLAYERS ?= " \
  /media/varun/PateoHdd2/YoctoBuild_Jenkins/poky-morty-16.0.1/meta \
  /media/varun/PateoHdd2/YoctoBuild_Jenkins/poky-morty-16.0.1/meta-poky \
  /media/varun/PateoHdd2/YoctoBuild_Jenkins/poky-morty-16.0.1/meta-yocto-bsp \
  "
```
